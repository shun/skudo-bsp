## sources/meta-skudo/conf/layer.conf
```bitbake
# We have a conf and classes directory, add to BBPATH
BBPATH .= ":${LAYERDIR}"
# We have recipes-* directories, add to BBFILES
BBFILES += "${LAYERDIR}/recipes/*/*.bb \
			${LAYERDIR}/recipes/*/*/*.bb \
			"

BBFILE_COLLECTIONS += "core"
BBFILE_PATTERN_core = "^${LAYERDIR}/"
BBFILE_PRIORITY_core = "8"

# This should only be incremented on significant changes that will
# cause compatibility issues with other layers
LAYERVERSION_core = "3"
```

## sources/meta-skudo/conf/machine/marsboard.conf
```bitbake
#@TYPE: Machine
#@NAME: MarS Board
#@SOC: i.MX6Q
#@DESCRIPTION: Machine configuration for MarS Board

include conf/machine/include/imx-base.inc
include conf/machine/include/tune-cortexa9.inc

SOC_FAMILY = "mx6:mx6q:marsboard"

PREFERRED_PROVIDER_virtual/kernel = "linux-marsboard"
KERNEL_IMAGETYPE = "uImage"

UBOOT_SUFFIX = "bin"
UBOOT_PADDING = "2"
PREFERRED_PROVIDER_u-boot = "u-boot-imx"
UBOOT_MACHINE = "mx6qsabresd"

SERIAL_CONSOLE = "115200 ttymxc1"

MACHINE_FEATURES += " alsa irda wifi bluetooth usbhost"
```
